## tests/test_app_build/testcase.yaml
```yaml
tests:
  # cb_getting_started.build.nucleo_u385rg_q:
  #   tags:
  #     - cb_getting_started
  #     - smoke
  #   build_only: true
  #   platform_allow:
  #     - nucleo_u385rg_q
  #   extra_args:
  #     - CONF_FILE=../../../samples/cb_getting_started/prj.conf;../../../samples/cb_getting_started/prj_log.conf

  app.build.rpi_pico2_rp2350a_m33:
    tags:
      - app_build
      - smoke
    build_only: true
    platform_allow:
      - rpi_pico2/rp2350a/m33
    extra_args:
      - CONF_FILE=../../app/prj.conf;../../app/prj_log.conf
      - DTC_OVERLAY_FILE=../../app/boards/rpi_pico2_rp2350a_m33.overlay
      - EXTRA_CONF_FILE=../../app/boards/rpi_pico2_rp2350a_m33.conf
```

## tests/test_probe/testcase.yaml
```yaml
tests:
  cb_jtag_probe.test_probe.pytest:
    sysbuild: true
    harness: pytest
    timeout: 120
    extra_args:
      - APP_DIR=/workspace/cb_jtag_probe.fw/app
    tags:
      - cb_jtag_probe
      - pytest
      - jtag
    platform_allow:
      - rpi_pico2/rp2350a/m33
    integration_platforms:
      - rpi_pico2/rp2350a/m33
    harness_config:
      pytest_dut_scope: class
      pytest_root:
        - "test_probe_interface.py"
```

## west.yml
```yaml
# West manifest for cb_jtag_probe firmware
#
# Usage:
#   west init -m <this-repo-url> --mr <branch/tag>
#   west update
#
# This manifest uses the T2 star topology: the application repo is the
# west manifest repo and it imports Zephyr's own west.yml so all module
# revisions are kept in sync with the chosen Zephyr release.

manifest:
  defaults:
    remote: zephyrproject

  remotes:
    - name: zephyrproject
      url-base: https://github.com/zephyrproject-rtos

  projects:
    - name: zephyr
      remote: zephyrproject
      revision: v4.4.0
      import: true


    - name: cb_zephyr_modules
      url: https://github.com/chriesibaum/cb_zephyr_modules
      revision: main     # todo: pin to a specific commit or tag once the repo is stable
      path: modules/cb_zephyr_modules

  self:
    path: cb_jtag_probe.fw
```
